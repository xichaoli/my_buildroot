## package/openssh/Config.in
```kconfig
config BR2_PACKAGE_OPENSSH
	bool "openssh"
	depends on BR2_USE_MMU # fork()
	select BR2_PACKAGE_OPENSSL
	select BR2_PACKAGE_ZLIB
	help
	  A free version of the SSH protocol suite of network connectivity
	  tools. The standard 'ssh', 'sshd', 'scp', and friends.

	  http://www.openssh.com/

if BR2_PACKAGE_OPENSSH

config BR2_PACKAGE_OPENSSH_UNSAFE_CONF
	bool "openssh server unsafe configure file"
	help
	  Use a sshd_config that can login in root with password.
endif
```

## package/openvas-cli/Config.in
```kconfig
config BR2_PACKAGE_OPENVAS_CLI
    select BR2_PACKAGE_MANAGER
	bool "openvas-cli"
	help
	  This is the client module for the Open Vulnerability Assessment System.
```

## package/openvas-libraries/Config.in
```kconfig
config BR2_PACKAGE_OPENVAS_LIBRARIES
    select BR2_PACKAGE_LIBGLIB2
    select BR2_PACKAGE_LIBGCRYPT
    select BR2_PACKAGE_LIBGPGME
    select BR2_PACKAGE_LIBPCAP
    select BR2_PACKAGE_LIBKSBA
    select BR2_PACKAGE_LIBSSH
    select BR2_PACKAGE_GNUTLS
	select BR2_PACKAGE_HIREDIS
    select BR2_PACKAGE_UTIL_LINUX
	bool "openvas-libraries"
	help
	  This is the libraries module for the Open Vulnerability Assessment System.
```

## package/openvas-manager/Config.in
```kconfig
config BR2_PACKAGE_OPENVAS_MANAGER
    select BR2_PACKAGE_OPENVAS_SCANNER
    select BR2_PACKAGE_SQLITE
	bool "openvas-manager"
	help
	  This is the manage module for the Open Vulnerability Assessment System.
```

## package/openvas-scanner/Config.in
```kconfig
config BR2_PACKAGE_OPENVAS_SCANNER
	select BR2_PACKAGE_OPENVAS_LIBRARIES
	bool "openvas-scanner"
	help
```

## package/shadow/Config.in
```kconfig
config BR2_PACKAGE_SHADOW
	bool "shadow"
	depends on BR2_PACKAGE_BUSYBOX_SHOW_OTHERS
	help
	  This package contains utilities to add, modify, and delete users and groups;
	  set and change their passwords; and perform other administrative tasks. 

	  http://pkg-shadow.alioth.debian.org/releases/
```
